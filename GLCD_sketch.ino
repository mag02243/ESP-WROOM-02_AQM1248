/*
#include <Arduino.h>
#include <ESP8266WiFi.h>
#include <Ticker.h>
#include <WiFiClient.h>
#include <FS.h>
#include <time.h>
extern "C" {
#include "user_interface.h"
}
*/
#include "GLCD.h"

GLCD lcd;

// w:128 h:41
const uint8_t _logo[16 * 48] PROGMEM = {
0x00, 0x00, 0x00, 0x00, 0x00, 0x00, 0x00, 0x00, 0x00, 0x00, 0x00, 0x00, 0x00, 0x00, 0x00, 0x00,
0x00, 0x00, 0x00, 0x00, 0x00, 0x00, 0x00, 0x00, 0x00, 0x00, 0x00, 0x00, 0x00, 0x00, 0x00, 0x00,
0x00, 0x00, 0x00, 0x00, 0x00, 0x00, 0x00, 0x00, 0x00, 0x00, 0x00, 0x00, 0x00, 0x00, 0x00, 0x00,
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0x00, 0x00, 0x00, 0x00, 0x00, 0x00, 0x00, 0x00, 0x00, 0x00, 0x00, 0x00, 0x00, 0x00, 0x00, 0x00
};

//------------------------------------------------------------
// 初期化
void setup() {
  // USB初期化
  Serial.begin(115200);
  delay(500);
  Serial.println();

  lcd.begin();
  logo();
}

//------------------------------------------------------------
// logo
void logo()
{
  lcd.clear();
  for (uint8_t y = 0; y < 48; y++) {
    for (uint8_t x = 0; x < (128 + 7) >> 3; x++) {
      const uint8_t *p = _logo + y * 16 + x;
      uint8_t c = pgm_read_byte(p);
      for (uint8_t k = 0; k < 8; k++) {
        lcd.SetPixel(x * 8 + k, y, (c & (1 << (7 - k))) != 0 ? GLCD_BLACK : GLCD_WHITE);
      }
    }
  }
}

// グラフ表示
void drawGraph5(uint8_t *data, uint8_t max, uint8_t min, char *label100, char *label50, char *label0)
{
  char buf[8], w[5];
  dtostrf(10.0, 4, 0, w);
  sprintf(buf, "%4sW", w);
  lcd.kprint32(24, 20, buf, GLCD_BLACK, GLCD_WHITE);

  lcd.FontPos(0, 16);
  lcd.print(label100);
  lcd.FontPos(0, 32);
  lcd.print(label50);
  lcd.FontPos(0, 56 - 8);
  lcd.print(label0);
  lcd.FontPos(24, 65 - 8);
  lcd.print("-10h");
  lcd.FontPos(128 - 6 * 3, 65 - 8);
  lcd.print("now");
  lcd.Line(24, 16, 24, 56);
  lcd.Line(24, 56, 126, 56);
  for (uint8_t i = 0; i < 100; i++) {
    uint8_t d1 = data[i];
    if (d1 < min)
      d1 = min;
    if (d1 > max)
      d1 > max;
    lcd.Line(24 + i, 56 - 1, 24 + i, 56 - 1 - (d1 - min) * 40 / (max - min));
  }
}

//------------------------------------------------------------
// メインループ
uint8_t ix = 0;

void loop() {
  if (ix == 0) {
    lcd.clear();
    lcd.Rectangle(ix, ix, 127 - ix, 47 - ix);
  } else if (ix < 24) {
    lcd.beginBackGroundDraw();
    lcd.clear();
    lcd.Rectangle(ix, ix, 127 - ix, 47 - ix);
    lcd.endBackGroundDraw();
  } else if (ix == 24) {
    lcd.clear();
    lcd.FontPos(0, 0);
    lcd.print("0123456789012345678901");
    lcd.FontPos(1, 8);
    lcd.print("ABCDEFGHIJKLMNOPQRSTUV", true);
    lcd.FontPos(2, 16);
    lcd.print("abcdefghijklmnopqrstuv");
    lcd.FontPos(3, 24);
    lcd.print("ｱｲｳｴｵｶｷｸｹｺｻｼｽｾｿﾀﾁﾂﾃﾄﾅ", true);
    uint8_t userFont[5] = {
      0x42, 0x61, 0x51, 0x49, 0x46
      /*
       _ M _ _ _ _ M _  0x42
       _ M M _ _ _ _ M  0x61
       _ M _ M _ _ _ M  0x51
       _ M _ _ M _ _ M  0x49
       _ M _ _ _ M M _  0x46
      */
    };
    lcd.setFont(0, userFont);
    lcd.FontPos(0, 24);
    lcd.put(0);
  } else if (ix == 25) {
    lcd.clear();
    lcd.kprint( 0,  0, "01234567890123456");
    lcd.kprint( 0, 12, "ABCDEFGHIJKLMNOPQ");
    lcd.kprint( 0, 24, "あいうえおかきくけこ漢字も");
    lcd.kprint( 0, 36, "アイウエオカキクケ表示できます！");
  } else if (ix == 26) {
    lcd.clear();
    lcd.kprint32( 0,  0, "ABCDEFGH");
    lcd.kprint32( 0, 24, "abcdefgh");
  } else if (ix == 27) {
    logo();
  }
  if (ix < 24)
    delay(100);
  else
    delay(5000);
  ix++;
  if (ix >= 28)
    ix = 0;

//  wdt_enable(WDTO_8S);
  wdt_reset();
}
